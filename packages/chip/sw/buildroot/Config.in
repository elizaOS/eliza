## packages/chip/sw/buildroot/Config.in
```kconfig
menu "Eliza e1 BSP"

config BR2_PACKAGE_ELIZA_E1_BSP
	bool "Eliza e1 BSP smoke hooks"
	help
	  Import metadata for the Eliza e1 software BSP. The hardware
	  register contract is owned by sw/platform/e1_platform_contract.json.

source "$BR2_EXTERNAL_ELIZA_E1_PATH/package/e1-mmio-smoke/Config.in"
source "$BR2_EXTERNAL_ELIZA_E1_PATH/package/e1-npu-ml-smoke/Config.in"

endmenu
```

## packages/chip/sw/buildroot/configs/eliza_e1_defconfig
```kconfig
# Minimal Buildroot defconfig for the Eliza e1 software BSP.
#
# This file is meant to be copied into an external Buildroot tree as:
#   configs/eliza_e1_defconfig
#
# It is not a checked-in Buildroot release. The checked-in source contract is
# sw/platform/e1_platform_contract.json, with generated constants such as
# E1_NPU_BASE, E1_DMA_BASE, and E1_DISPLAY_BASE.
BR2_riscv=y
BR2_RISCV_64=y
BR2_RISCV_ISA_RVA=y
BR2_RISCV_ISA_RVC=y
BR2_RISCV_ISA_RVD=y
BR2_RISCV_ISA_RVF=y
BR2_RISCV_ABI_LP64D=y
BR2_TOOLCHAIN_BUILDROOT_GLIBC=y
BR2_INIT_BUSYBOX=y
BR2_SYSTEM_DHCP="eth0"
BR2_TARGET_GENERIC_HOSTNAME="eliza-e1"
BR2_TARGET_GENERIC_ISSUE="Eliza e1 BSP"
BR2_ROOTFS_OVERLAY="$(BR2_EXTERNAL_ELIZA_E1_PATH)/board/eliza/e1/rootfs_overlay"
BR2_LINUX_KERNEL=y
BR2_LINUX_KERNEL_CUSTOM_VERSION=y
BR2_LINUX_KERNEL_CUSTOM_VERSION_VALUE="6.12.90"
BR2_LINUX_KERNEL_USE_CUSTOM_CONFIG=y
BR2_LINUX_KERNEL_CUSTOM_CONFIG_FILE="$(BR2_EXTERNAL_ELIZA_E1_PATH)/board/eliza/e1/linux.fragment"
BR2_LINUX_KERNEL_DTS_SUPPORT=y
BR2_LINUX_KERNEL_INTREE_DTS_NAME="eliza-e1"
BR2_TARGET_ROOTFS_CPIO=y
BR2_TARGET_ROOTFS_CPIO_GZIP=y
BR2_PACKAGE_ELIZA_E1_BSP=y
BR2_PACKAGE_E1_MMIO_SMOKE=y
BR2_PACKAGE_E1_NPU_ML_SMOKE=y
```

## packages/chip/sw/buildroot/package/e1-mmio-smoke/Config.in
```kconfig
config BR2_PACKAGE_HELLO_MMIO_SMOKE
	bool "hello-mmio-smoke"
	depends on BR2_USE_MMU
	help
	  Tiny C tool that mmaps /dev/mem and reads the NPU and DMA scratch
	  registers from sw/platform/hello_platform_contract.json. Useful as a
	  first-light userspace BSP check before /dev/hello-npu and the DMA
	  sysfs node are wired up.

	  https://github.com/openphone/openphone-ai-soc
```

## packages/chip/sw/buildroot/package/e1-npu-ml-smoke/Config.in
```kconfig
config BR2_PACKAGE_E1_NPU_ML_SMOKE
	bool "e1-npu-ml-smoke"
	depends on BR2_USE_MMU
	help
	  Target-side /dev/e1-npu GEMM_S8 smoke. This is a deterministic
	  Linux driver/runtime check and rejects CPU-only fallback.

	  It is not NNAPI, Android HAL, or hardware benchmark evidence.
```

## packages/chip/sw/buildroot/package/hello-npu-ml-smoke/Config.in
```kconfig
config BR2_PACKAGE_HELLO_NPU_ML_SMOKE
	bool "hello NPU ML smoke"
	help
	  Build the fail-closed /dev/hello-npu GEMM_S8 target smoke.
```

## packages/chip/sw/firemarshal/eliza-e1-linux-smoke/opensbi-eliza_defconfig
```kconfig
# The generated AP is single-hart for this smoke path. OpenSBI generic
# fdt_ipi_init can stall while probing/touching the CLINT MSWI half; Linux
# does not need an SBI IPI device before userspace smoke starts.
# CONFIG_FDT_IPI is not set
# CONFIG_FDT_IPI_MSWI is not set
# OpenSBI hangs in the generic FDT PLIC cold init on the generated AP path.
# Linux still receives the PLIC node in the DTB and probes it in S-mode.
# CONFIG_FDT_IRQCHIP is not set
# CONFIG_FDT_IRQCHIP_PLIC is not set
CONFIG_FDT_RESET=y
CONFIG_FDT_RESET_HTIF=y
CONFIG_FDT_RESET_SIFIVE_TEST=y
CONFIG_FDT_SERIAL=y
CONFIG_FDT_SERIAL_SIFIVE=y
CONFIG_FDT_TIMER=y
CONFIG_FDT_TIMER_MTIMER=y
```

## packages/chip/sw/linux/Documentation/devicetree/bindings/eliza/eliza,e1-display.yaml
```yaml
# SPDX-License-Identifier: (GPL-2.0-only OR BSD-2-Clause)
%YAML 1.2
---
$id: http://devicetree.org/schemas/eliza/eliza,e1-display.yaml#
$schema: http://devicetree.org/meta-schemas/core.yaml#

title: Eliza e1 display (simple-framebuffer compatible)

maintainers:
  - Eliza e1 BSP <bsp@eliza.invalid>

description: |
  4 KiB MMIO display scan-out block at E1_DISPLAY_BASE per
  sw/platform/e1_platform_contract.json. The driver programs FB_BASE /
  MODE / FORMAT / ENABLE from DT and expects a sibling "simple-framebuffer"
  node for /dev/fb0.

properties:
  compatible:
    const: eliza,e1-display

  reg:
    maxItems: 1

  interrupts:
    maxItems: 1

  interrupt-names:
    items:
      - const: IRQ_VSYNC

  eliza,mode:
    $ref: /schemas/types.yaml#/definitions/uint32
    description: Packed MODE register value (height<<16 | width).

  eliza,format:
    $ref: /schemas/types.yaml#/definitions/uint32
    description: Pixel format four-cc as a u32 (default "XR24" = 0x34325258).

  eliza,fb-base:
    $ref: /schemas/types.yaml#/definitions/uint32
    description: Physical base address of the framebuffer in DRAM.

required:
  - compatible
  - reg
  - interrupt-names
  - eliza,mode
  - eliza,format
  - eliza,fb-base

additionalProperties: false

examples:
  - |
    display@10030000 {
        compatible = "eliza,e1-display";
        reg = <0x10030000 0x1000>;
        interrupt-names = "IRQ_VSYNC";
        eliza,mode = <0x050002d0>;
        eliza,format = <0x34325258>;
        eliza,fb-base = <0x80000000>;
    };
```

## packages/chip/sw/linux/Documentation/devicetree/bindings/eliza/eliza,e1-npu.yaml
```yaml
# SPDX-License-Identifier: (GPL-2.0-only OR BSD-2-Clause)
%YAML 1.2
---
$id: http://devicetree.org/schemas/eliza/eliza,e1-npu.yaml#
$schema: http://devicetree.org/meta-schemas/core.yaml#

title: Eliza e1 NPU

maintainers:
  - Eliza e1 BSP <bsp@eliza.invalid>

description: |
  4 KiB MMIO NPU block defined by sw/platform/e1_platform_contract.json
  (E1_NPU_BASE). The kernel driver creates /dev/e1-npu with read/ioctl/
  mmap and registers OP_A/OP_B/OPCODE/RESULT/PERF counters per the contract.

properties:
  compatible:
    const: eliza,e1-npu

  reg:
    maxItems: 1
    description: 4 KiB MMIO window at E1_NPU_BASE.

  interrupts:
    maxItems: 1
    description: IRQ_NPU completion line (optional - polled fallback supported).

  interrupt-names:
    items:
      - const: IRQ_NPU

required:
  - compatible
  - reg

additionalProperties: false

examples:
  - |
    npu@10020000 {
        compatible = "eliza,e1-npu";
        reg = <0x10020000 0x1000>;
        interrupt-names = "IRQ_NPU";
    };
```

## packages/chip/sw/linux/drivers/e1/Kconfig
```kconfig
menuconfig ELIZA_E1_BSP
	tristate "Eliza e1 BSP drivers"
	depends on OF
	help
	  Enables importable Linux drivers for the Eliza e1 platform
	  contract described by sw/platform/e1_platform_contract.json.

if ELIZA_E1_BSP

config ELIZA_E1_NPU
	tristate "Eliza e1 NPU contract driver"
	depends on MISC_DEVICES
	help
	  Exposes the eliza,e1-npu MMIO node through /dev/e1-npu for
	  smoke tests. The register base is E1_NPU_BASE in the platform
	  contract.

config ELIZA_E1_DMA
	tristate "Eliza e1 DMA contract driver"
	help
	  Binds the eliza,e1-dma MMIO node and exports a read-only sysfs
	  contract file for fast BSP validation.

endif
```

## packages/chip/sw/linux/drivers/eliza/Kconfig
```kconfig
menuconfig ELIZA_E1_BSP
	tristate "Eliza e1 SoC BSP drivers"
	depends on OF
	help
	  Out-of-tree style BSP drivers for the Eliza e1 platform
	  contract (sw/platform/e1_platform_contract.json). Drop this
	  directory into an external Linux tree under drivers/misc/eliza-e1/
	  and source this Kconfig from drivers/misc/Kconfig.

if ELIZA_E1_BSP

config ELIZA_E1_NPU
	tristate "Eliza e1 NPU character driver"
	depends on MISC_DEVICES
	help
	  Creates /dev/e1-npu and exposes the NPU register window through
	  read(), ioctl() (submit OP_A/OP_B/OPCODE), and mmap() of the 4 KiB
	  MMIO region. Bound to compatible "eliza,e1-npu".

config ELIZA_E1_DMA
	tristate "Eliza e1 DMA platform driver"
	help
	  Binds compatible "eliza,e1-dma" and exports a multi-line
	  platform-contract sysfs node plus live readback of BYTES_DONE and
	  ERROR_COUNT.

config ELIZA_E1_DISPLAY
	tristate "Eliza e1 display (simple-framebuffer compatible)"
	help
	  Programs FB_BASE / MODE / FORMAT / ENABLE from device tree and
	  leaves scan-out for userspace via a sibling simple-framebuffer
	  node. Bound to compatible "eliza,e1-display".

config ELIZA_E1_GPIO
	tristate "Eliza e1 GPIO (gpio-mmio backed)"
	depends on GPIOLIB
	select GPIO_GENERIC
	help
	  Wraps the GPIO_OUT register inside the peripheral-control window as
	  a 32-line gpio-mmio gpiochip. Bound to compatible
	  "eliza,e1-gpio".

endif # ELIZA_E1_BSP
```

## packages/chip/sw/opensbi/platform/eliza/configs/defconfig
```kconfig
# OpenSBI kconfig for the eliza e1_chip_cpu_variant platform.
# Enables only the fixed (non-FDT) drivers platform.c references:
#   ns16550a UART (uart8250), RISC-V PLIC, ACLINT MTIMER + MSWI (CLINT).
CONFIG_SERIAL_UART8250=y
CONFIG_IRQCHIP_PLIC=y
CONFIG_IPI_MSWI=y
CONFIG_TIMER_MTIMER=y
```

## packages/research/chip/sw/linux/Documentation/devicetree/bindings/eliza/eliza,e1-dma.yaml
```yaml
# SPDX-License-Identifier: (GPL-2.0-only OR BSD-2-Clause)
%YAML 1.2
---
$id: http://devicetree.org/schemas/eliza/eliza,e1-dma.yaml#
$schema: http://devicetree.org/meta-schemas/core.yaml#

title: Eliza e1 DMA

maintainers:
  - Eliza e1 BSP <bsp@eliza.invalid>

description: |
  4 KiB MMIO DMA contract block at E1_DMA_BASE per
  sw/platform/e1_platform_contract.json. The driver exports a sysfs
  contract string and live counters; it is not a dma-engine provider.

properties:
  compatible:
    const: eliza,e1-dma

  reg:
    maxItems: 1

  interrupts:
    maxItems: 1

  interrupt-names:
    items:
      - const: IRQ_DMA

required:
  - compatible
  - reg

additionalProperties: false

examples:
  - |
    dma@10010000 {
        compatible = "eliza,e1-dma";
        reg = <0x10010000 0x1000>;
        interrupt-names = "IRQ_DMA";
    };
```

## packages/research/chip/sw/linux/Documentation/devicetree/bindings/eliza/eliza,e1-gpio.yaml
```yaml
# SPDX-License-Identifier: (GPL-2.0-only OR BSD-2-Clause)
%YAML 1.2
---
$id: http://devicetree.org/schemas/eliza/eliza,e1-gpio.yaml#
$schema: http://devicetree.org/meta-schemas/core.yaml#

title: Eliza e1 GPIO

maintainers:
  - Eliza e1 BSP <bsp@eliza.invalid>

description: |
  32-bit GPIO_OUT register at E1_PERIPHERAL_CONTROL_BASE +
  E1_PERIPH_GPIO_OUT_OFFSET, wrapped as a 32-line gpiochip via gpio-mmio.

properties:
  compatible:
    const: eliza,e1-gpio

  reg:
    maxItems: 1
    description: 4 KiB peripheral-control window covering GPIO_OUT.

  gpio-controller: true

  "#gpio-cells":
    const: 2

required:
  - compatible
  - reg
  - gpio-controller
  - "#gpio-cells"

additionalProperties: false

examples:
  - |
    gpio@10000000 {
        compatible = "eliza,e1-gpio";
        reg = <0x10000000 0x1000>;
        gpio-controller;
        #gpio-cells = <2>;
    };
```

## packages/research/chip/sw/linux/configs/eliza_tier2_qemu_defconfig
```kconfig
# SPDX-License-Identifier: GPL-2.0-only
#
# Eliza Tier 2 minimal Linux defconfig fragment for qemu-system-riscv64 -M virt.
#
# Usage:
#   cd external/linux
#   make ARCH=riscv CROSS_COMPILE=riscv64-linux-gnu- defconfig
#   ./scripts/kconfig/merge_config.sh -m .config \
#       ../../sw/linux/configs/eliza_tier2_qemu_defconfig
#   make ARCH=riscv CROSS_COMPILE=riscv64-linux-gnu- olddefconfig
#   make ARCH=riscv CROSS_COMPILE=riscv64-linux-gnu- -j$(nproc) Image
#
# Goal: arch/riscv/boot/Image < 5 MB.

# --- Keep: RISC-V virt platform essentials ---
CONFIG_SMP=y
CONFIG_NR_CPUS=4
CONFIG_RISCV_SBI=y
CONFIG_RISCV_SBI_V01=y
CONFIG_HVC_RISCV_SBI=y
CONFIG_SERIAL_8250=y
CONFIG_SERIAL_8250_CONSOLE=y
CONFIG_SERIAL_OF_PLATFORM=y
CONFIG_OF=y
CONFIG_DEVTMPFS=y
CONFIG_DEVTMPFS_MOUNT=y
CONFIG_TMPFS=y
CONFIG_PROC_FS=y
CONFIG_SYSFS=y

# --- Keep: virtio for QEMU virt ---
CONFIG_VIRTIO=y
CONFIG_VIRTIO_MMIO=y
CONFIG_VIRTIO_BLK=y
CONFIG_VIRTIO_NET=y
CONFIG_VIRTIO_CONSOLE=y

# --- Keep: filesystems we need ---
CONFIG_EXT4_FS=y
CONFIG_BLK_DEV_INITRD=y
CONFIG_INITRAMFS_SOURCE=""
CONFIG_RD_GZIP=y

# --- Strip: heavyweight subsystems we do not need for a busybox boot ---
# CONFIG_NETFILTER is not set
# CONFIG_BTRFS_FS is not set
# CONFIG_XFS_FS is not set
# CONFIG_F2FS_FS is not set
# CONFIG_MD is not set
# CONFIG_BLK_DEV_DM is not set
# CONFIG_SCSI is not set
# CONFIG_ATA is not set
# CONFIG_USB_SUPPORT is not set
# CONFIG_SOUND is not set
# CONFIG_WIRELESS is not set
# CONFIG_WLAN is not set
# CONFIG_NFS_FS is not set
# CONFIG_NFSD is not set
# CONFIG_IPV6 is not set
# CONFIG_BRIDGE is not set
# CONFIG_VLAN_8021Q is not set
# CONFIG_DRM is not set
# CONFIG_FB is not set
# CONFIG_INPUT_JOYSTICK is not set
# CONFIG_INPUT_TABLET is not set
# CONFIG_INPUT_TOUCHSCREEN is not set
# CONFIG_BT is not set
# CONFIG_CAN is not set
# CONFIG_MTD is not set
# CONFIG_NFC is not set

# --- Size knobs ---
CONFIG_CC_OPTIMIZE_FOR_SIZE=y
# CONFIG_KALLSYMS_ALL is not set
# CONFIG_DEBUG_INFO is not set
# CONFIG_DEBUG_KERNEL is not set
# CONFIG_FTRACE is not set
```

## packages/research/chip/sw/opensbi/platform/eliza/Kconfig
```kconfig
# SPDX-License-Identifier: BSD-2-Clause
#
# Mandatory drivers/libraries for the eliza e1_chip_cpu_variant platform.
# Matches the fixed (non-FDT) drivers referenced by platform.c:
#   ns16550a UART (uart8250), RISC-V PLIC, ACLINT MTIMER + MSWI (CLINT).
config PLATFORM_ELIZA
	bool
	select IPI_MSWI
	select IRQCHIP_PLIC
	select SERIAL_UART8250
	select TIMER_MTIMER
	default y
```
