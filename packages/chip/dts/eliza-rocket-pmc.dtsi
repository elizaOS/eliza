// SPDX-License-Identifier: GPL-2.0-only OR BSD-2-Clause
/*
 * Eliza E1 — OpenSBI device-tree fragment for the PMC RPMI shmem mailbox.
 *
 * This fragment is consumed by OpenSBI's
 * `lib/utils/mailbox/fdt_mailbox_rpmi_shmem.c` driver at M-mode init. It
 * describes the four RPMI v1.0 queues and the A2P doorbell that the AON
 * Ibex PMC (`fw/pmc/src/rpmi_server.c`) implements on the silicon side.
 *
 * Geometry MUST match `fw/pmc/include/rpmi_shmem_layout.h`:
 *   slot-size                     64 bytes (RPMI_SLOT_SIZE_MIN)
 *   slots per queue               4 (2 header + 2 data)
 *   queue size                    256 bytes
 *   region base                   0x10050800 (PMC mailbox base + 0x800)
 *   a2p-req                       0x10050800 .. 0x100508FF
 *   p2a-ack                       0x10050900 .. 0x100509FF
 *   p2a-req                       0x10050A00 .. 0x10050AFF
 *   a2p-ack                       0x10050B00 .. 0x10050BFF
 *   a2p-doorbell                  0x10050C00 (4 B, write-only on host side)
 *
 * Doorbell value (`riscv,a2p-doorbell-value`) is fixed at 0x1; the Ibex PMC
 * checks for a non-zero write and clears it on ingest.
 *
 * No P2A doorbell sysmsi is declared: the AON PMC raises the existing
 * `pmc_wake_irq_o` line (PLIC source) when it posts to p2a-ack / p2a-req.
 * `riscv,p2a-doorbell-sysmsi-index` is therefore omitted, which makes the
 * OpenSBI driver default it to `-1U` and rely on polling-with-timeout
 * (RPMI_DEF_RX_TIMEOUT) — acceptable for the prototype roundtrip.
 *
 * Include this fragment from a board-level .dts that defines the rest of
 * the SoC (CPU, PLIC, CLINT, DRAM).  See the self-contained
 * `dts/eliza-rocket-pmc.dts` for the OpenSBI-build artifact that consumes
 * this fragment via FW_FDT_PATH.
 */

/ {
	soc {
		pmc_mbox: mailbox@10050800 {
			compatible = "riscv,rpmi-shmem-mbox";

			/* Region list, one per reg-name.  The OpenSBI driver
			 * walks both lists in lockstep: the first 4 reg
			 * entries are the queues (in RPMI_QUEUE_IDX order),
			 * the trailing entry is the a2p-doorbell. */
			reg = <0x10050800 0x100>,   /* a2p-req      */
			      <0x10050900 0x100>,   /* p2a-ack      */
			      <0x10050A00 0x100>,   /* p2a-req      */
			      <0x10050B00 0x100>,   /* a2p-ack      */
			      <0x10050C00 0x004>;   /* a2p-doorbell */
			reg-names = "a2p-req",
				    "p2a-ack",
				    "p2a-req",
				    "a2p-ack",
				    "a2p-doorbell";

			riscv,slot-size = <64>;
			riscv,a2p-doorbell-value = <0x1>;

			#mbox-cells = <1>;
		};
	};
};
